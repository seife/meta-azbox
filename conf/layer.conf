## conf/layer.conf
```bitbake
# We have a conf and classes directory, add to BBPATH
BBPATH .= ":${LAYERDIR}"

# We have a recipes-* directories, add to BBFILES
BBFILES += "${LAYERDIR}/recipes-*/*/*.bb \
	${LAYERDIR}/recipes-*/*/*.bbappend"

BBFILE_COLLECTIONS += "azbox"
BBFILE_PATTERN_azbox = "^${LAYERDIR}/"
BBFILE_PRIORITY_azbox = "6"
```

## conf/machine/azbox.conf
```bitbake
#@TYPE: Machine
#@NAME: azbox

#@DESCRIPTION: Machine configuration for azbox systems

require conf/machine/include/tune-mips32.inc

MACHINE_FEATURES = "screen keyboard pci usbhost ext2 ext3 serial"

KERNEL_IMAGETYPE = "vmlinux"
KERNEL_ALT_IMAGETYPE = "vmlinux.bin"
KERNEL_IMAGE_STRIP_EXTRA_SECTIONS  = ".comment"

PREFERRED_PROVIDER_virtual/kernel ?= "linux-yocto-custom"



SERIAL_CONSOLE = "115200 ttyS0"
USE_VT ?= "0"

MACHINE_EXTRA_RRECOMMENDS = " kernel-modules"

IMAGE_FSTYPES ?= "jffs2 tar.bz2"
JFFS2_ERASEBLOCK = "0x10000"
```

## conf/machine/azboxme.conf
```bitbake
## i don't think this is used anywhere...
MACHINE_NAME = "Me"
KERNEL_EXTRA_CMD = "--disable-compressor=lzo "
SOC_FAMILY = "smp8655"

# these are really used
require conf/machine/include/default-settings.inc
require conf/machine/include/azbox.inc

EXTRA_IMAGEDEPENDS += " \
    kmod-native \
    "

IMAGE_FSTYPES ?= "jffs2.sum azboxme-update-img"

TARGET_ARCH = "mipsel"
DEFAULTTUNE = "mips32el"
```
